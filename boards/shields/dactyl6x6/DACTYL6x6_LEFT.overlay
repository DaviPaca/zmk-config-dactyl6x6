//#*
//# * Copyright (c) 2020 Ryan Cross, Bruce Jones
//# *
//# * SPDX-License-Identifier: MIT
//# *

#include "DACTYL6x6.dtsi"
#include "dactyl_6x6-layouts.dtsi"


    &physical_layout0 {
      kscan = <&kscan0>;
      transform = <&default_transform>;
    };
    
&kscan0{  
      compatible = "zmk,kscan-gpio-matrix";
      
  col-gpios
           =<&pro_micro 4 GPIO_ACTIVE_HIGH>
           ,<&pro_micro 5 GPIO_ACTIVE_HIGH>
           ,<&pro_micro 6 GPIO_ACTIVE_HIGH>
           ,<&pro_micro 7 GPIO_ACTIVE_HIGH>
           ,<&pro_micro 8 GPIO_ACTIVE_HIGH>
           ,<&pro_micro 9 GPIO_ACTIVE_HIGH>
           ;
};