#*
# * Copyright (c) 2020 Ryan Cross, Bruce Jones
# *
# * SPDX-License-Identifier: MIT
# *
 / {
    physical_layout0: physical_layout_0 {
        compatible = "zmk,physical-layout";
        display-name = "Default Layout";
    };
};