## boards/shields/dactyl6x6/Kconfig.defconfig
```kconfig
# Copyright (c) 2021 The ZMK Contributors
# SPDX-License-Identifier: MIT

if SHIELD_DACTYL6x6_LEFT
  config ZMK_KEYBOARD_NAME
    default "dactyl_left"

  config ZMK_SPLIT_BLE_ROLE_CENTRAL
    default y

endif

if SHIELD_DACTYL6x6_RIGHT
  config ZMK_KEYBOARD_NAME
    default "dactyl_right"

endif    

if SHIELD_DACTYL6x6_LEFT || SHIELD_DACTYL6x6_RIGHT

  config ZMK_SPLIT
    default y
  config ZMK_SPLIT_BLE
    default y

endif
```

## boards/shields/dactyl6x6/Kconfig.shield
```kconfig
# Copyright (c) 2020 The ZMK Contributors
# SPDX-License-Identifier: MIT

config SHIELD_DACTYL6x6_LEFT
  def_bool $(shields_list_contains,DACTYL6x6_LEFT)


config SHIELD_DACTYL6x6_RIGHT
  def_bool $(shields_list_contains,DACTYL6x6_RIGHT)
```

## boards/shields/dactyl6x6/kconfig.defconfig
```kconfig
# Copyright (c) 2021 The ZMK Contributors
# SPDX-License-Identifier: MIT

if SHIELD_DACTYL6x6_LEFT
  config ZMK_KEYBOARD_NAME
    default "dactyl_left"

  config ZMK_SPLIT_BLE_ROLE_CENTRAL=y

endif

if SHIELD_DACTYL6x6_RIGHT
  config ZMK_KEYBOARD_NAME
    default "dactyl_right"

endif    

if SHIELD_DACTYL6x6_LEFT || SHIELD_DACTYL6x6_RIGHT

  config ZMK_SPLIT=y

endifS
```

## config/board/shields/dactyl6x6/Kconfig.shield
```kconfig
config SHIELD_DACTYL6x6_LEFT
  def_bool $(shields_list_contains, dactyl6x6_left)
  config SHIELD_DACTYL6x6_RIGHT
  def_bool $(shields_list_contains, dactyl6x6_right)
```
